#include <behaviors.dtsi>
#include <dt-bindings/zmk/bt.h>
#include <dt-bindings/zmk/keys.h>
#include <dt-bindings/zmk/outputs.h>
#include <dt-bindings/zmk/rgb.h>
#include <input/processors.dtsi>

// Include the shared keymap — this provides the full keymap{} block
#include "../../../../config/keys.keymap"
