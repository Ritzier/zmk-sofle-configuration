## sofle/config/west.yml
```yaml
manifest:
  remotes:
    - name: zmkfirmware
      url-base: https://github.com/zmkfirmware
    # Customize UI
    - name: gpeye
      url-base: https://github.com/GPeye
  projects:
    - name: eyelash_sofle
      url: https://github.com/a741725193/zmk-sofle
      revision: main
    - name: zmk
      remote: zmkfirmware
      revision: v0.3.0
      import: app/west.yml
    # Customize UI
    - name: urchin-peripheral-animation
      remote: gpeye
      revision: main
  self:
    path: boards
```
